## boards/shields/kin42/Kconfig.shield
```kconfig
# Copyright (c) 2020 The ZMK Contributors
# SPDX-License-Identifier: MIT

config SHIELD_KIN42_LEFT
    def_bool $(shields_list_contains,kin42_left)

config SHIELD_KIN42_RIGHT
    def_bool $(shields_list_contains,kin42_right)
```
